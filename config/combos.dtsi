#define COMBO(NAME, BINDINGS, KEYPOS, LAYERS, MS) \
  combo_##NAME { \
    bindings = <BINDINGS>; \
    key-positions = <KEYPOS>; \
    layers = <LAYERS>; \
    timeout-ms = <MS>; \
  };

combos {
  compatible = "zmk,combos";

};
