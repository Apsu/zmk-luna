## config/boards/shields/luna/Kconfig.defconfig
```kconfig
# Copyright (c) 2020 The ZMK Contributors
# SPDX-License-Identifier: MIT

if SHIELD_LUNA_LEFT

config ZMK_KEYBOARD_NAME
	default "Luna"

config ZMK_SPLIT_BLE_ROLE_CENTRAL
	default y

endif

if SHIELD_LUNA_RIGHT || SHIELD_LUNA_LEFT

config ZMK_SPLIT
	default y

endif

config CONFIG_ZMK_COMBO_MAX_COMBOS_PER_KEY
	int "Maximum number of combos per key"
	default 50
```
